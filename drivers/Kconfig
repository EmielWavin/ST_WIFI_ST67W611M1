## drivers/wifi/st67w611m1/Kconfig
```kconfig
# SPDX-License-Identifier: Apache-2.0

config WIFI_ST67W611M1
	bool "ST67W611M1 Wi-Fi NCP driver"
	depends on SPI && GPIO
	help
	  Enable the ST67W611M1 Wi-Fi NCP driver. This driver communicates
	  with the NCP over SPI using a binary-framed AT command protocol
	  (T02 host-LwIP profile). The NCP handles 802.11 while the host
	  runs the full IP stack.

if WIFI_ST67W611M1

module = WIFI_ST67W611M1
module-str = wifi_st67w611m1
source "subsys/logging/Kconfig.template.log_config"

endif # WIFI_ST67W611M1
```

## dts/bindings/wifi/st,st67w611m1.yaml
```yaml
# SPDX-License-Identifier: Apache-2.0

description: >
  ST67W611M1 Wi-Fi NCP module. All control and data traffic travels over a
  binary-framed SPI bus (T02 host-LwIP profile). The NCP asserts data-ready-gpios
  when it has data ready for the host to read.

compatible: "st,st67w611m1"

include: spi-device.yaml

properties:
  data-ready-gpios:
    type: phandle-array
    required: true
    description: >
      SPI_RDY / DATA_READY pin. NCP asserts this HIGH when it has data
      ready for the host. Mapped to EXTI for interrupt-driven receive.

  boot-gpios:
    type: phandle-array
    description: >
      BOOT pin. Assert HIGH before power-on to put the NCP into factory
      UART bootstrap mode (QConn_Flash firmware update). Leave de-asserted
      for normal operation.

  chip-en-gpios:
    type: phandle-array
    description: >
      CHIP_EN pin. Drive HIGH to enable the module, LOW to power it down.
```

## west.yml
```yaml
manifest:
  remotes:
    - name: zephyrproject-rtos
      url-base: https://github.com/zephyrproject-rtos

  projects:
    - name: zephyr
      remote: zephyrproject-rtos
      revision: v3.7.1
      import:
        name-allowlist:
          - cmsis

  self:
    path: ST_WIFI_ST67W611M1
```
